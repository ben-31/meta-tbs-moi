## conf/distro/moi.conf
```bitbake
DISTRO = "moi"
DISTRO_NAME = "TBS Moi new version"
DISTRO_VERSION = "3.0"

PACKAGE_CLASSES ?= "package_ipk"
TCLIBC ?= "musl"

INIT_MANAGER ?= "mdev-busybox"

TCLIBCAPPEND ?= ""
TMPDIR .= "${TCLIBCAPPEND}"

DISTRO_FEATURES ?= "ext2 ipv4 ipv6 ldconfig nfs nls overlayfs pam usbgagdget usbhost usrmerge vfat xattr zeroconf"

DISTRO_FEATURES_BACKFILL_CONSIDERED:append = " sysvinit systemd"
VIRTUAL-RUNTIME_dev_manager = "busybox-mdev"
VIRTUAL-RUNTIME_init_manager = "busybox"
VIRTUAL-RUNTIME_initscripts = "initscripts"
VIRTUAL-RUNTIME_keymaps = "keymaps"
VIRTUAL-RUNTIME_login_manager = "busybox"
PREFERRED_PROVIDER_virtual/libiconv = "libiconv"
```

## conf/layer.conf
```bitbake
# We have a conf and classes directory, add to BBPATH
BBPATH .= ":${LAYERDIR}"

# We have recipes-* directories, add to BBFILES
BBFILES += "${LAYERDIR}/recipes-*/*/*.bb ${LAYERDIR}/recipes-*/*/*.bbappend"

BBFILE_COLLECTIONS += "tbs-moi"
BBFILE_PATTERN_tbs-moi = "^${LAYERDIR}/"
BBFILE_PRIORITY_tbs-moi = "1"

# This should only be incremented on significant changes that will
# cause compatibility issues with other layers
LAYERVERSION_tbs-moi = "2"

LAYERDEPENDS_tbs-moi = "core \
    filesystems-layer \
    openembedded-layer \
    networking-layer \
    multimedia-layer \
    meta-python"

LAYERSERIES_COMPAT_tbs-moi = "scarthgap"
```

## conf/machine/tbs2900.conf
```bitbake
require conf/machine/include/arm/armv7a/tune-cortexa8.inc

KERNEL_IMAGETYPE ?= "zImage"
KERNEL_DEVICETREE ?= "samsung/s5pv210-smdkv210.dtb"
# append device tree to zImage (see kernel-devicetree.bbclass)
KERNEL_DEVICETREE_BUNDLE ?= "1"

PREFERRED_PROVIDER_virtual/kernel ?= "linux-dummy"
# PREFERRED_PROVIDER_virtual/kernel ?= "linux-tbs-moi"
# PREFERRED_PROVIDER:virtual/bootloader ?= "u-boot"

# UBOOT_EXTLINUX = "1"
# UBOOT_EXTLINUX_ROOT = "/dev/mmcblk2p2"
# UBOOT_LOADADDRESS = "0x32000000"

PREFERRED_VERSION:linux-yocto ??= "6.%"

IMAGE_BOOT_FILES ?= "zImage"

IMAGE_INSTALL:append = " kernel-modules media-ctl i2c-tools"

IMAGE_TYPES:append:tbs2900 = "yaffs2"
IMAGE_CMD:yaffs2 = "mkyaffs2image ${IMAGE_ROOTFS} ${IMGDEPLOYDIR}/MOI2900_fs.bin ${EXTRA_IMAGECMD}"
do_image_yaffs2[depends] += "yaffs2-utils-native:do_populate_sysroot"

IMAGE_FSTYPES ?= "yaffs2 tar.gz"

MACHINE_FEATURES += "serial ext2 ext3 ext4 usbgadget usbhost rtc"
KERNEL_DANGLING_FEATURES_WARN_ONLY = "1"

SERIAL_CONSOLES = "115200;ttySAC0"
USE_VT = "0"
```
